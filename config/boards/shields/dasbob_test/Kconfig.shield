## config/boards/shields/dasbob_test/Kconfig.shield
```kconfig
# Copyright (c) 2024 The ZMK Contributors
# SPDX-License-Identifier: MIT

# config SHIELD_DASBOB_TEST
    # def_bool $(shields_list_contains,dasbob_single)


# DASBOB Keyboard Shield Configuration

config SHIELD_DASBOB_LEFT
    def_bool $(shields_list_contains,dasbob_left)

config SHIELD_DASBOB_RIGHT  
    def_bool $(shields_list_contains,dasbob_right)

 config SHIELD_DASBOB
    def_bool SHIELD_DASBOB_LEFT || SHIELD_DASBOB_RIGHT

if SHIELD_DASBOB

config ZMK_SPLIT
    default y

endif
```

## config/shields/dasbob_test/Kconfig.shield
```kconfig
# Copyright (c) 2024 The ZMK Contributors
# SPDX-License-Identifier: MIT

config SHIELD_DASBOB_TEST
    def_bool $(shields_list_contains,dasbob_test)
```
